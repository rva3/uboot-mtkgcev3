## configs/gcev3_defconfig
```kconfig
CONFIG_RISCV=y
CONFIG_SYS_ICACHE_OFF=y
CONFIG_SYS_DCACHE_OFF=y
CONFIG_TEXT_BASE=0xa8000000
CONFIG_NR_DRAM_BANKS=1
CONFIG_HAS_CUSTOM_SYS_INIT_SP_ADDR=y
CONFIG_CUSTOM_SYS_INIT_SP_ADDR=0xa8a00000
CONFIG_DEFAULT_DEVICE_TREE="gceemu"
CONFIG_SYS_LOAD_ADDR=0x0
CONFIG_DEBUG_UART_BASE=0x11002000
CONFIG_DEBUG_UART_CLOCK=26000000
CONFIG_DEBUG_UART=y
# CONFIG_RISCV_ISA_C is not set
# CONFIG_RISCV_ISA_F is not set
# CONFIG_AVAILABLE_HARTS is not set
CONFIG_OPTIMIZE_INLINING=y
CONFIG_ENV_VARS_UBOOT_CONFIG=y
CONFIG_SKIP_RELOCATE=y
# CONFIG_EFI_LOADER is not set
# CONFIG_BOOTSTD is not set
# CONFIG_LEGACY_IMAGE_FORMAT is not set
# CONFIG_BOARD_INIT is not set
CONFIG_OF_EMBED=y
CONFIG_NO_NET=y
CONFIG_CLK_AUTO_ID=y
CONFIG_CLK_STUB=y
CONFIG_BAUDRATE=921600
CONFIG_DEBUG_UART_SHIFT=2
CONFIG_DEBUG_UART_ANNOUNCE=y
CONFIG_DEBUG_UART_SKIP_INIT=y
CONFIG_MTK_SERIAL=y
```
